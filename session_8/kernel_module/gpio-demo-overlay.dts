/dts-v1/;
/plugin/;

/ {
    compatible = "brcm,bcm2711";

    fragment@0 {
        target-path = "/";
        __overlay__ {
            gpio_demo: gpio-demo {
                compatible = "training,gpio-demo";

                led-gpios = <&gpio 17 0>;
                button-gpios = <&gpio 27 1>;

                status = "okay";
            };
        };
    };
};